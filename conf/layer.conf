## conf/layer.conf
```bitbake
# We have a conf and classes directory, append to BBPATH
BBPATH .= ":${LAYERDIR}"

# We have a recipes directory, add to BBFILES
BBFILES += "${LAYERDIR}/recipes*/*/*.bb ${LAYERDIR}/recipes*/*/*.bbappend"

BBFILE_COLLECTIONS += "oe-tracking"
BBFILE_PATTERN_oe-tracking := "^${LAYERDIR}/"
BBFILE_PRIORITY_oe-tracking = "7"
```
